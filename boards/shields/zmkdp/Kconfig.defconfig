## boards/shields/zmkdp/Kconfig.defconfig
```kconfig
if SHIELD_ZMKDP_LEFT

# Name must be less than 16 characters long!
config ZMK_KEYBOARD_NAME
    default "zmkdp"

config ZMK_SPLIT_ROLE_CENTRAL
    default y

# 实际只存在一个外围（右半）：build.yaml 里的 zmkdp_third 是注释掉的。
# ZMK 的 start_scanning() 只在「每个已配置槽位都连上」时才停扫，设成 2
# 会让左半永远在空扫一个不会出现的第二个外围；已连接状态下持续扫描会
# 抢射频时间、影响链路稳定性。所以这里必须是 1。
config ZMK_SPLIT_BLE_CENTRAL_PERIPHERALS
    default 1

config BT_MAX_CONN
    default 7

config BT_MAX_PAIRED
    default 7

# Bump this value needed for concurrent GATT discovery of splits
config BT_L2CAP_TX_BUF_COUNT
    default 15 if ZMK_SPLIT_ROLE_CENTRAL

endif

if SHIELD_ZMKDP_LEFT || SHIELD_ZMKDP_RIGHT || SHIELD_ZMKDP_THIRD

config ZMK_SPLIT
    default y

endif

# --- Pinctrl Kconfig for part "left" ---
if BOARD_NICE_NANO_V2 && SHIELD_ZMKDP_LEFT

config I2C
    default y

config ZMK_DISPLAY
    default y

if ZMK_DISPLAY

config I2C
    default y

config SSD1306
    default y

endif # ZMK_DISPLAY

if LVGL

config LV_Z_VDB_SIZE
    default 64

config LV_DPI_DEF
    default 148

config LV_Z_BITS_PER_PIXEL
    default 1

choice LV_COLOR_DEPTH
    default LV_COLOR_DEPTH_1
endchoice

endif # LVGL

config SPI
    default y

config WS2812_STRIP
    default y

endif

# --- Pinctrl Kconfig for part "right" ---
if BOARD_NICE_NANO_V2 && SHIELD_ZMKDP_RIGHT

config I2C
    default y

config ZMK_DISPLAY
    default y

if ZMK_DISPLAY

config I2C
    default y

config SSD1306
    default y

endif # ZMK_DISPLAY

if LVGL

config LV_Z_VDB_SIZE
    default 64

config LV_DPI_DEF
    default 148

config LV_Z_BITS_PER_PIXEL
    default 1

choice LV_COLOR_DEPTH
    default LV_COLOR_DEPTH_1
endchoice

endif # LVGL

config SPI
    default y

config WS2812_STRIP
    default y

endif
```
